/dts-v1/;

#include "mt7981b-gainstrong-oolite-mt7981b.dtsi"

/ {
	model = "GainStrong Oolite-MT7981B V1 Module (emmc boot, SODIMM4 form factor)";
	compatible = "gainstrong,oolite-mt7981b-module-emmc-boot", "mediatek,mt7981";

	chosen {
		bootargs = "rootwait root=PARTLABEL=rootfs";
	};
};
