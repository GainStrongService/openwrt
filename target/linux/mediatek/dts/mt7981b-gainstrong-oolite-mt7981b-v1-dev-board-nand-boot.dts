/dts-v1/;

#include "mt7981b-gainstrong-oolite-mt7981b-v1.dtsi"
#include "mt7981b-gainstrong-oolite-mt7981b-v1-nand.dtsi"
#include "mt7981b-gainstrong-oolite-mt7981b-v1-dev-board.dtsi"
#include "mt7981b-gainstrong-oolite-mt7981b-v1-mtd-macaddr.dtsi"

/ {
	model = "GainStrong Oolite-MT7981B V1 Dev Board (NAND boot)";
	compatible = "gainstrong,oolite-mt7981b-v1-dev-board-nand-boot", "mediatek,mt7981";
};
