/dts-v1/;

#include "mt7981b-gainstrong-oolite-mt7981b.dtsi"
#include "mt7981b-gainstrong-oolite-mt7981b-nor-boot.dtsi"
#include "mt7981b-gainstrong-oolite-mt7981b-dev-board.dtsi"
#include "mt7981b-gainstrong-oolite-mt7981b-mtd-macaddr.dtsi"

/ {
	model = "GainStrong Oolite-MT7981B V1 Dev Board (nor boot)";
	compatible = "gainstrong,oolite-mt7981b-dev-board-nor-boot", "mediatek,mt7981";

};
