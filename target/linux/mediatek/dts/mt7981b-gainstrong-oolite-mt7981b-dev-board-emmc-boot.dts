/dts-v1/;

#include "mt7981b-gainstrong-oolite-mt7981b.dtsi"
#include "mt7981b-gainstrong-oolite-mt7981b-dev-board.dtsi"

/ {
	model = "GainStrong Oolite-MT7981B V1 Dev Board (emmc boot)";
	compatible = "gainstrong,oolite-mt7981b-dev-board-emmc-boot", "mediatek,mt7981";

	chosen {
		bootargs = "rootwait root=PARTLABEL=rootfs";
	};
};
