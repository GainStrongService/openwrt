#include "mt7628an_gainstrong_oolite-34s.dtsi"

/ {
	compatible = "gainstrong,hnt-light-hotspot", "gainstrong,oolite-34s", "mediatek,mt7628an-soc";
	model = "HNT Light Hotspot";
};

&firmware {
		reg = <0x50000 0x1fb0000>;
};
