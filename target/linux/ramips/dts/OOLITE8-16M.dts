/dts-v1/;

#include "OOLITE8.dtsi"

/ {
	compatible = "gainstrong,oolite-v8-16m", "gainstrong,oolite-v8", "mediatek,mt7621-soc";
	model = "GainStrong Oolite v8 (16M flash)";

};

&firmware {
	reg = <0x50000 0xfb0000>;
};
