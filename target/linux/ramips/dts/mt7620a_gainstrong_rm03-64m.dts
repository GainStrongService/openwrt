#include "mt7620a_gainstrong_rm03.dtsi"

/ {
	compatible = "gainstrong,rm03-64m", "gainstrong,rm03", "ralink,mt7620a-soc";
	model = "Gainstrong RM03 (64M Flash)";
};

&firmware {
		reg = <0x50000 0x3fb0000>;
};
