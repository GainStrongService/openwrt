
#include "mt7621_gainstrong_oolite-v8.dtsi"

/ {
	compatible = "gainstrong,oolite-v8-64m", "gainstrong,oolite-v8", "mediatek,mt7621-soc";
	model = "GainStrong Oolite V8 (64M flash)";

};

&firmware {
	reg = <0x50000 0x3fb0000>;
};

&all {
	reg = <0x0 0x4000000>;
};
