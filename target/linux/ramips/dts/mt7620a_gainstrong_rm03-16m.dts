#include "mt7620a_gainstrong_rm03.dtsi"

/ {
	compatible = "gainstrong,rm03-16m", "gainstrong,rm03", "ralink,mt7620a-soc";
	model = "Gainstrong RM03 (16M Flash)";
};

&firmware {
		reg = <0x50000 0xfb0000>;
};
