#include "mt7628an_gainstrong_oolite-v3x.dtsi"

/ {
	compatible = "gainstrong,oolite-v3x-8m", "gainstrong,oolite-v3x", "mediatek,mt7628an-soc";
	model = "Gainstrong Oolite V3.X (8M Flash)";
};

&firmware {
		reg = <0x50000 0x7b0000>;
};
