/dts-v1/;

#include "OOLITE8.dtsi"

/ {
	compatible = "gainstrong,oolite-v8-8m", "gainstrong,oolite-v8", "mediatek,mt7621-soc";
	model = "GainStrong Oolite v8 (8M flash)";

};

&firmware {
	reg = <0x50000 0x7b0000>;
};
