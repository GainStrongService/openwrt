#include "qca9531_gainstrong.dtsi"

/ {
	model = "GainStrong Oolite V5.X (8M flash)";
	compatible = "gainstrong,oolite-v5-8m", "gainstrong,minibox-v3-8m", "qca,qca9531";
};

&firmware {
	reg = <0x020000 0x7d0000>;
};

&art {
	reg = <0x7f0000 0x010000>;
};
