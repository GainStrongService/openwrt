#include "qca9531_gainstrong.dtsi"

/ {
	model = "Gainstrong Minibox v3 8M";
	compatible = "gainstrong,minibox-v3-8m", "gainstrong,oolite-v5-8m", "qca,qca9531";
};

&firmware {
	reg = <0x020000 0x7d0000>;
};

&art {
	reg = <0x7f0000 0x010000>;
};
