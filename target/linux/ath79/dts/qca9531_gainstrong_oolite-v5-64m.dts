#include "qca9531_gainstrong.dtsi"

/ {
	model = "GainStrong Oolite V5.X (64M flash)";
	compatible = "gainstrong,oolite-v5-64m", "gainstrong,minibox-v3-64m", "qca,qca9531";
};

&firmware {
	reg = <0x020000 0x3fd0000>;
};

&art {
	reg = <0x3ff0000 0x010000>;
};
