#include "qca9531_gainstrong.dtsi"

/ {
	model = "Gainstrong Minibox v3 32M";
	compatible = "gainstrong,minibox-v3-32m", "gainstrong,oolite-v5-32m", "qca,qca9531";
};

&firmware {
	reg = <0x020000 0x1fd0000>;
};

&art {
	reg = <0x1ff0000 0x010000>;
};
